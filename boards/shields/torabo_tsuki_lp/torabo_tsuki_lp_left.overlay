#include "torabo_tsuki_lp.dtsi"
#include <input/processors.dtsi>
#include <dt-bindings/zmk/input_transform.h>

/ {
    touchpad_listener: touchpad_listener {
        compatible = "zmk,input-listener";
        status = "okay";
        device = <&touchpad>;
    };
};

&i2c0 {
    status = "okay";
    compatible = "nordic,nrf-twim";
    pinctrl-0 = <&i2c0_default>;
    pinctrl-1 = <&i2c0_sleep>;
    pinctrl-names = "default", "sleep";
    clock-frequency = <I2C_BITRATE_FAST>;
    zephyr,concat-buf-size = <32>;

    touchpad: touchpad@56 {
        status = "okay";
        compatible = "azoteq,iqs7211e";
        reg = <0x56>;
        irq-gpios = <&gpio0 20 GPIO_PULL_UP>;
        power-gpios = <&gpio0 8 (GPIO_ACTIVE_HIGH | NRF_GPIO_DRIVE_H1)>;
    };
};
