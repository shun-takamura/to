/{
    split_inputs {
        #address-cells = <1>;
        #size-cells = <0>;

        touchpad_split: touchpad_split@0 {
            compatible = "zmk,input-split";
            reg = <0>;
            device = <&touchpad>;
        };
    };
};
